/*
 * This linker script was automatically generated by MicroTESK
 * Generation started: Mon Jun 08 14:10:13 GMT 2026
 *
 * Ivannikov Institute for System Programming of the Russian Academy of Sciences (ISP RAS)
 * 25 Alexander Solzhenitsyn st., Moscow, 109004, Russia
 * http://forge.ispras.ru/projects/microtesk
 */

ENTRY(_start)
SECTIONS
{
  . = 0x80000000;
  .text.init : { *(".text.init")}
  . = 0x80020000;
  .tohost : { *(".tohost")}
  . = 0x80021000;
  .text : { *(".text")}
  . = 0x80028000;
  .data : { *(".data")}
}